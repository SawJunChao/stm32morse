# file: A1T2_STM32F407VET6_Morse.ioc
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Mcu.Family=STM32F4
Mcu.Name=STM32F407V(E-G)Tx
Mcu.Package=LQFP100
NVIC.PriorityGroup=NVIC_PRIORITYGROUP_4
PA6.Signal=GPIO_Output
ProjectManager.HeapSize=0x200
ProjectManager.StackSize=0x400
ProjectManager.TargetToolchain=STM32CubeIDE
RCC.AHBFreq_Value=16000000
RCC.APB1Freq_Value=16000000
RCC.APB2Freq_Value=16000000
RCC.CortexFreq_Value=16000000
RCC.HSE_VALUE=25000000
RCC.HSI_VALUE=16000000
RCC.LSE_VALUE=32768
RCC.SYSCLKFreq_VALUE=16000000
RCC.VCOOutputFreq_Value=192000000
board=custom

// file: Core/Src/main.c
/* USER CODE BEGIN Header */
/**
  ******************************************************************************
  * @file           : main.c
  * @brief          : Main program body
  ******************************************************************************
  * @attention
  *
  * Copyright (c) 2022 STMicroelectronics.
  * All rights reserved.
  *
  * This software is licensed under terms that can be found in the LICENSE file
  * in the root directory of this software component.
  * If no LICENSE file comes with this software, it is provided AS-IS.
  *
  ******************************************************************************
  */
/* USER CODE END Header */
#include "main.h"

void SystemClock_Config(void);
static void MX_GPIO_Init(void);
/* USER CODE BEGIN PFP */
void space (void);
void dot (void);
void dash (void);
void space (void);
void letterA (void);
void letterB (void);
void letterC (void);
void letterD (void);
void letterE (void);
void letterF (void);
void letterG (void);
void letterH (void);
void letterI (void);
void letterJ (void);
void letterK (void);
void letterL (void);
void letterM (void);
void letterN (void);
void letterO (void);
void letterP (void);
void letterQ (void);
void letterR (void);
void letterS (void);
void letterT (void);
void letterU (void);
void letterV (void);
void letterW (void);
void letterX (void);
void letterY (void);
void letterZ (void);
void number1 (void);
void number2 (void);
void number3 (void);
void number4 (void);
void number5 (void);
void number6 (void);
void number7 (void);
void number8 (void);
void number9 (void);
void number0 (void);
/* USER CODE END PFP */

int main(void)
{

  /* MCU Configuration--------------------------------------------------------*/

  /* Reset of all peripherals, Initializes the Flash interface and the Systick. */
  HAL_Init();

  /* Configure the system clock */
  SystemClock_Config();

  /* Initialize all configured peripherals */
  MX_GPIO_Init();

  /* Infinite loop */
  while (1)
  {

	  // Generating Morse code for letter V, S and J
	  letterV();
	  letterS();
	  letterJ();

  }
}

void SystemClock_Config(void)
{
  RCC_OscInitTypeDef RCC_OscInitStruct = {0};
  RCC_ClkInitTypeDef RCC_ClkInitStruct = {0};

  /** Configure the main internal regulator output voltage
  */
  __HAL_RCC_PWR_CLK_ENABLE();
  __HAL_PWR_VOLTAGESCALING_CONFIG(PWR_REGULATOR_VOLTAGE_SCALE1);

  /** Initializes the RCC Oscillators according to the specified parameters
  * in the RCC_OscInitTypeDef structure.
  */
  RCC_OscInitStruct.OscillatorType = RCC_OSCILLATORTYPE_HSI;
  RCC_OscInitStruct.HSIState = RCC_HSI_ON;
  RCC_OscInitStruct.HSICalibrationValue = RCC_HSICALIBRATION_DEFAULT;
  RCC_OscInitStruct.PLL.PLLState = RCC_PLL_NONE;
  if (HAL_RCC_OscConfig(&RCC_OscInitStruct) != HAL_OK)
  {
    Error_Handler();
  }

  /** Initializes the CPU, AHB and APB buses clocks
  */
  RCC_ClkInitStruct.ClockType = RCC_CLOCKTYPE_HCLK|RCC_CLOCKTYPE_SYSCLK
                              |RCC_CLOCKTYPE_PCLK1|RCC_CLOCKTYPE_PCLK2;
  RCC_ClkInitStruct.SYSCLKSource = RCC_SYSCLKSOURCE_HSI;
  RCC_ClkInitStruct.AHBCLKDivider = RCC_SYSCLK_DIV1;
  RCC_ClkInitStruct.APB1CLKDivider = RCC_HCLK_DIV1;
  RCC_ClkInitStruct.APB2CLKDivider = RCC_HCLK_DIV1;

  if (HAL_RCC_ClockConfig(&RCC_ClkInitStruct, FLASH_LATENCY_0) != HAL_OK)
  {
    Error_Handler();
  }
}

static void MX_GPIO_Init(void)
{
  GPIO_InitTypeDef GPIO_InitStruct = {0};

  /* GPIO Ports Clock Enable */
  __HAL_RCC_GPIOA_CLK_ENABLE();

  /*Configure GPIO pin Output Level */
  HAL_GPIO_WritePin(GPIOA, GPIO_PIN_6, GPIO_PIN_RESET);

  /*Configure GPIO pin : PA6 */
  GPIO_InitStruct.Pin = GPIO_PIN_6;
  GPIO_InitStruct.Mode = GPIO_MODE_OUTPUT_PP;
  GPIO_InitStruct.Pull = GPIO_NOPULL;
  GPIO_InitStruct.Speed = GPIO_SPEED_FREQ_LOW;
  HAL_GPIO_Init(GPIOA, &GPIO_InitStruct);

}

/* USER CODE BEGIN 4 */

// Space between letters (3 units delay)
void space (void){
	HAL_Delay(1200);
}

// Space between parts of same letter (1 unit delay)
void shortSpace (void){
	HAL_Delay(400);
}

// Creates dot for Morse (1 unit delay)
void dot (void){
	//Turn on LED connected to PA6
	HAL_GPIO_WritePin(GPIOA, GPIO_PIN_6, GPIO_PIN_RESET);
	shortSpace();
	//Turn off LED connected to PA6
	HAL_GPIO_WritePin(GPIOA, GPIO_PIN_6, GPIO_PIN_SET);
	shortSpace();
}

// Creates dash for Morse (3 units delay)
void dash (void){
	//Turn on LED connected to PA6
	HAL_GPIO_WritePin(GPIOA, GPIO_PIN_6, GPIO_PIN_RESET);
	space();
	//Turn off LED connected to PA6
	HAL_GPIO_WritePin(GPIOA, GPIO_PIN_6, GPIO_PIN_SET);
	shortSpace();
}

// Morse functions for each letters and the numbers
void letterA (void) {dot();dash();space();}
void letterB (void) {dash();dot();dot();dot();space();}
void letterC (void) {dash();dot();dash();dot();space();}
void letterD (void) {dash();dot();dot();space();}
void letterE (void) {dot();space();}
void letterF (void) {dot();dot();dash();dot();space();}
void letterG (void) {dash();dash();dot();space();}
void letterH (void) {dot();dot();dot();dot();space();}
void letterI (void) {dot();dot();space();}
void letterJ (void) {dot();dash();dash();dash();space();}
void letterK (void) {dash();dot();dash();space();}
void letterL (void) {dot();dash();dot();dot();space();}
void letterM (void) {dash();dash();space();}
void letterN (void) {dash();dot();space();}
void letterO (void) {dash();dash();dash();space();}
void letterP (void) {dot();dash();dash();dot();space();}
void letterQ (void) {dash();dash();dot();dash();space();}
void letterR (void) {dot();dash();dot();space();}
void letterS (void) {dot();dot();dot();space();}
void letterT (void) {dash();space();}
void letterU (void) {dot();dot();dash();space();}
void letterV (void) {dot();dot();dot();dash();space();}
void letterW (void) {dot();dash();dash();space();}
void letterX (void) {dash();dot();dot();dash();space();}
void letterY (void) {dash();dot();dash();dash();space();}
void letterZ (void) {dash();dash();dot();dot();space();}
void number1 (void) {dot();dash();dash();dash();dash();space();}
void number2 (void) {dot();dot();dash();dash();dash();space();}
void number3 (void) {dot();dot();dot();dash();dash();space();}
void number4 (void) {dot();dot();dot();dot();dash();space();}
void number5 (void) {dot();dot();dot();dot();dot();space();}
void number6 (void) {dash();dot();dot();dot();dot();space();}
void number7 (void) {dash();dash();dot();dot();dot();space();}
void number8 (void) {dash();dash();dash();dot();dot();space();}
void number9 (void) {dash();dash();dash();dash();dot();space();}
void number0 (void) {dash();dash();dash();dash();dash();space();}

/* USER CODE END 4 */

void Error_Handler(void)
{
  __disable_irq();
  while (1)
  {
  }
}
